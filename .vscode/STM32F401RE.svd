# STM32F401RE register map
File version: 1.0
STM32F401RE Microcontroller
Registers are 32-bit, read-write, reset 0x0 unless marked. A register's access mark holds for its fields unless they carry their own. Offsets are from the block's base; lines under a group give offsets from that group; [hi:lo] are bit positions; {n}, {i} and the like mark numbered series; 'fields as' and 'values as' point back to an identical list; <NAME> marks a mode.

## Memory map
0x40020000 GPIOA — General-purpose I/Os

## GPIOA — General-purpose I/Os
Base 0x40020000
0x00 MODER — GPIO port mode register
  [1:0] MODER0 — Port x configuration bits (y = 0..15)
